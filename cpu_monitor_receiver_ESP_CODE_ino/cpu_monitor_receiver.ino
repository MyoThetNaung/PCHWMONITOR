#include <U8g2lib.h>

// WINDOW LOGO CCP

const unsigned char epd_bitmap_loading42x42[] PROGMEM = {
	0x00, 0x00, 0x00, 0x00, 0x00, 0x00, 0x00, 0x00, 0x00, 0x00, 0x00, 0x00, 0x00, 0x00, 0x00, 0x00, 
	0x00, 0x00, 0x00, 0x00, 0x00, 0x00, 0x00, 0x00, 0x00, 0x00, 0x00, 0x00, 0x07, 0x00, 0x00, 0x00, 
	0x00, 0xfe, 0x07, 0x00, 0x00, 0x00, 0xf8, 0xff, 0x07, 0x00, 0x00, 0xfc, 0xf9, 0xff, 0x07, 0x00, 
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	0x00, 0x00, 0x00, 0x00, 0x00, 0x00, 0x00, 0x00, 0x00, 0x00, 0x00, 0x00
};




// Initialize U8g2 for SH1106 128x64 OLED (I2C)
U8G2_SH1106_128X64_NONAME_F_SW_I2C u8g2(U8G2_R0, SCL, SDA, U8X8_PIN_NONE);

String cpu = "--";
String ram = "--";
String gpu = "--";
String input = "";

bool dataReceived = false;

void setup() {
  u8g2.begin();
  Serial.begin(115200);
  input.reserve(64);

  drawLoading();  // Show loading 
}

void loop() {
  while (Serial.available()) {
    char c = Serial.read();
    if (c == '\n') {
      parseData(input);
      input = "";
      dataReceived = true;
    } else {
      input += c;
    }
  }

  if (dataReceived) {
    drawDisplay();  // Show CPU, RAM, and GPU 
  } else {
    drawLoading();  // Keep showing loading screen until data is received
  }

  delay(100);
}

void parseData(String data) {
  int cpuIndex = data.indexOf("CPU:");
  int ramIndex = data.indexOf("RAM:");
  int gpuIndex = data.indexOf("GPU:");

  if (cpuIndex != -1 && ramIndex != -1 && gpuIndex != -1) {
    cpu = data.substring(cpuIndex + 4, ramIndex - 1);
    ram = data.substring(ramIndex + 4, gpuIndex - 1);
    gpu = data.substring(gpuIndex + 4);
  }
}

void drawDisplay() {
  u8g2.clearBuffer();
  u8g2.drawFrame(0, 0, 128, 64);
  u8g2.drawFrame(1, 1, 126, 62);
  u8g2.setFont(u8g2_font_logisoso16_tf);

  char line1[20];
  char line2[20];
  char line3[20];
  sprintf(line1, "CPU : %s%%", cpu.c_str());
  sprintf(line2, "GPU : %s%%", gpu.c_str());
  sprintf(line3, "RAM : %s%%", ram.c_str());

  u8g2.setCursor(20, 20);
  u8g2.print(line1);
  u8g2.setCursor(20, 40);
  u8g2.print(line2);
  u8g2.setCursor(20, 60);
  u8g2.print(line3);

  u8g2.sendBuffer();
}

void drawLoading() {
  u8g2.clearBuffer();
  u8g2.drawFrame(0, 0, 128, 64);
  // Draw the 32x32 loading bitmap centered at (48, 16)
  u8g2.drawXBMP(43, 8, 42, 42, epd_bitmap_loading42x42);

  // Display the "Waiting for data..."
  u8g2.setFont(u8g2_font_6x12_tf);
  u8g2.setCursor(16, 55);
  u8g2.print("Waiting for data");

  u8g2.sendBuffer();
}
